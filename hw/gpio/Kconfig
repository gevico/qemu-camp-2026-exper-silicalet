## hw/gpio/Kconfig
```kconfig
config PL061
    bool

config GPIO_KEY
    bool

config GPIO_MPC8XXX
    bool

config GPIO_PWR
    bool

config SIFIVE_GPIO
    bool

config G233_GPIO
    bool
    depends on HAVE_RUST
    select X_G233_GPIO_RUST

config STM32L4X5_GPIO
    bool

config PCA9552
    bool
    depends on I2C

config PCA9554
    bool
    depends on I2C

config PCF8574
    bool
    depends on I2C

config ZAURUS_SCOOP
    bool
```

## hw/watchdog/Kconfig
```kconfig
config CMSDK_APB_WATCHDOG
    bool
    select PTIMER

config WDT_IB6300ESB
    bool
    default y if PCI_DEVICES
    depends on PCI

config WDT_IB700
    bool
    default y
    depends on ISA_BUS

config WDT_DIAG288
    bool

config WDT_IMX2
    bool

config WDT_SBSA
    bool

config G233_WDT
    bool
    depends on HAVE_RUST
    select X_G233_WDT_RUST

config ALLWINNER_WDT
    bool
    select PTIMER
```

## rust/hw/Kconfig
```kconfig
# devices Kconfig
source gpio/Kconfig
source char/Kconfig
source i2c/Kconfig
source timer/Kconfig
source watchdog/Kconfig
```
